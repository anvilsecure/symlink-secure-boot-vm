## configs/anvil_symlink-qemu_defconfig
```kconfig
# Architecture
BR2_x86_64=y

# Target
BR2_TARGET_GENERIC_HOSTNAME="Anvil-Demo"
BR2_TARGET_GENERIC_ISSUE="Welcome to Anvil's Symlink Demo"
BR2_TARGET_GENERIC_ROOT_PASSWD="toor"
# BR2_TARGET_ROOTFS_TAR is not set
# BR2_TARGET_ROOTFS_CPIO_GZIP is not set
# BR2_TARGET_ROOTFS_EXT2 is not set
BR2_TARGET_ROOTFS_INITRAMFS=y

# directories
BR2_GLOBAL_PATCH_DIR="$(BR2_EXTERNAL_ANVIL_SYMLINK_DEMO_PATH)/patches"
BR2_ROOTFS_OVERLAY="$(BR2_EXTERNAL_ANVIL_SYMLINK_DEMO_PATH)/board/anvil/symlink-qemu/rootfs_overlay"
BR2_ROOTFS_POST_BUILD_SCRIPT="$(BR2_EXTERNAL_ANVIL_SYMLINK_DEMO_PATH)/board/anvil/symlink-qemu/post-build.sh"
BR2_ROOTFS_POST_IMAGE_SCRIPT="$(BR2_EXTERNAL_ANVIL_SYMLINK_DEMO_PATH)/board/anvil/symlink-qemu/post-image.sh"
BR2_LINUX_KERNEL_CUSTOM_CONFIG_FILE="$(BR2_EXTERNAL_ANVIL_SYMLINK_DEMO_PATH)/board/anvil/symlink-qemu/linux.config"

# Toolchain
BR2_TOOLCHAIN_BUILDROOT_WCHAR=y

# system
BR2_SYSTEM_DHCP="eth0"

# rootfs
BR2_ROOTFS_POST_SCRIPT_ARGS="$(BR2_DEFCONFIG)"

# kernel
BR2_LINUX_KERNEL=y
BR2_LINUX_KERNEL_CUSTOM_VERSION=y
BR2_LINUX_KERNEL_CUSTOM_VERSION_VALUE="5.4.35"
BR2_LINUX_KERNEL_USE_CUSTOM_CONFIG=y

# packages
BR2_PACKAGE_HOST_LINUX_HEADERS_CUSTOM_5_4=y
BR2_PACKAGE_PYTHON3=y
BR2_PACKAGE_PYTHON3_BZIP2=y
BR2_PACKAGE_PYTHON3_XZ=y
BR2_PACKAGE_PYTHON_REQUESTS=y
BR2_PACKAGE_LIGHTTPD=y
BR2_PACKAGE_LIGHTTPD_PCRE=y
BR2_PACKAGE_VSFTPD=y
BR2_PACKAGE_NANO=y
BR2_PACKAGE_HOST_QEMU=y
BR2_PACKAGE_HOST_QEMU_SYSTEM_MODE=y
```
